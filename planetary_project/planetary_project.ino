// TO install some dependencies https://github.com/me-no-dev/ESPAsyncWebServer
// https://github.com/me-no-dev/ESPAsyncWebServer/archive/master.zip
// sketch->include_library->add .zip libray
//#include <ESP8266WiFi.h>
#include "ESPAsyncTCP.h"
#include "ESPAsyncWebServer.h"
#include "ArduinoJson.h"
#include "AsyncJson.h"

#define maxRow 16
#define maxColumn 16

int demultPos[4] = {
  D0, D1, D2, D3
};
int demultNeg[4] = {
  D4, D5, D6, D7
};
int demultMap[16][4] = {
  {0,0,0,0}, //ABCD
  {1,0,0,0}, //ABCD
  {0,1,0,0}, //ABCD
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  {1,1,1,1}, //ABCD
};

int constelationMatrix[13][16][16] = {
  {
  {0,0,0,0,0,0,0,0,0,0,0,0,0,0,0,0},
  {0,0,0,0,1,0,0,0,0,0,0,0,0,0,0,0},
  {0,0,0,0,0,0,0,1,0,0,0,0,0,0,0,0},
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  {0,0,0,0,0,0,0,0,0,0,0,0,0,0,0,0},
},
{
  {0,0,1,0,0,0,0,0,0,0,0,0,0,0,0,0},
  {0,0,0,0,1,0,0,0,0,0,0,0,0,0,0,0},
  {0,0,0,0,0,0,0,0,0,0,0,0,0,0,0,0},
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  {0,0,0,0,0,0,0,0,0,0,0,0,0,0,0,0},
}, {
  {0,0,0,0,0,1,0,0,0,0,0,0,0,0,0,0},
  {0,0,0,1,0,0,0,0,0,0,1,0,0,0,0,0},
  {0,0,0,0,0,0,0,1,0,1,0,0,0,0,0,0},
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  {0,0,0,0,0,0,0,0,0,0,0,0,0,0,0,0},
}, {
  {0,0,0,0,0,0,0,0,0,0,0,0,0,0,0,0},
  {0,0,0,0,0,0,0,0,0,0,0,1,0,0,0,0},
  {0,0,0,0,0,0,0,0,0,0,0,0,0,0,0,0},
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  {0,0,0,0,0,0,0,0,0,0,0,0,0,0,0,0},
}, {
  {0,0,0,0,0,0,0,0,0,1,0,0,0,0,0,0},
  {0,0,0,0,0,0,0,0,0,0,1,0,0,0,0,0},
  {0,0,0,0,0,0,0,1,0,0,0,0,0,0,0,0},
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  {0,0,0,0,0,0,0,0,0,0,0,0,0,0,0,0},
}, {
  {0,0,0,0,1,0,1,0,0,0,0,0,0,0,0,0},
  {0,0,0,0,0,0,0,1,0,1,0,0,0,0,0,0},
  {0,0,0,0,0,0,0,0,1,0,0,0,0,0,0,0},
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  {0,0,0,0,0,0,0,0,0,0,0,0,0,0,0,0},
}, {
  {0,0,0,0,0,0,0,0,0,1,0,0,0,0,0,0},
  {0,0,0,0,0,0,0,0,0,0,1,0,0,0,0,0},
  {0,0,0,0,0,0,0,0,1,0,0,0,0,0,0,0},
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  {0,0,0,0,0,0,0,0,0,0,0,0,0,0,0,0},
}, {
  {0,0,0,0,0,0,0,0,0,0,0,0,1,0,0,0},
  {0,0,0,0,0,0,0,0,0,0,1,0,0,1,0,0},
  {0,0,0,0,0,0,0,0,1,1,0,0,1,0,0,0},
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  {0,0,0,0,0,0,0,0,0,0,0,0,0,0,0,0},
}, {
  {0,0,0,0,0,0,1,0,0,0,0,0,0,0,0,0},
  {0,0,0,0,1,0,1,0,0,0,0,0,0,0,0,0},
  {0,0,0,0,0,1,0,1,1,0,0,0,0,0,0,0},
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  {0,0,0,0,0,0,0,0,0,0,0,0,0,0,0,0},
}, {
  {0,0,0,0,0,0,0,0,0,0,1,0,0,0,0,0},
  {0,0,0,0,0,0,0,0,0,0,1,0,0,0,0,0},
  {0,0,0,1,1,0,1,0,1,0,0,0,0,0,0,0},
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  {0,0,0,0,0,0,0,0,0,0,0,0,0,0,0,0},
}, {
  {0,0,0,0,0,0,0,0,0,0,0,0,0,0,0,0},
  {0,0,0,0,0,0,1,0,1,0,0,0,1,0,0,0},
  {0,0,0,0,0,1,0,1,0,0,1,0,0,0,0,0},
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  {0,0,0,0,0,0,0,0,0,0,0,0,0,0,0,0},
}, {
  {0,0,0,0,0,0,0,0,0,0,0,0,1,0,0,0},
  {0,0,0,0,1,0,0,0,0,0,0,1,0,1,0,0},
  {0,0,0,1,0,0,0,0,0,0,0,1,1,0,0,0},
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  {0,0,0,0,0,0,0,0,0,0,0,0,0,0,0,0},
}, {
  {0,0,0,0,0,0,0,0,0,0,0,0,0,0,0,0},
  {0,0,0,0,0,0,0,0,0,0,0,0,0,0,0,0},
  {0,0,0,0,0,0,0,0,0,0,0,0,0,0,0,0},
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  {0,0,0,0,0,0,0,0,0,0,0,0,0,0,0,0},
},
};


int debugMatrix[5][3][3] = {
  {
  {0,0,0},
  {0,1,0},
  {0,0,0}
},
{
  {0,0,0},
  {0,0,0},
  {0,0,1}
}, {
  {0,1,0},
  {1,1,1},
  {0,1,0}
}, {
  {1,0,1},
  {0,1,0},
  {1,0,1}
}, {
  {1,1,1},
  {1,1,1},
  {1,1,1}
}
};

int debugging = 1;

int negDemultPin = D8;

const char* ssid = "GP Planetary Network"; //"Galaxy A02sf5b8";  //"LYKENET HENRIQUE";
const char* password = "123456789"; //"stjs8259";     //"19061984";
AsyncWebServer server(80);
int status = 0;
int selectedConst = 0;

void onBody(AsyncWebServerRequest *request, uint8_t *data, size_t len, size_t index, size_t total){
  if(!index){
    Serial.printf("BodyStart: %u B\n", total);
  }
  for(size_t i=0; i<len; i++){
    Serial.write(data[i]);
  }
  if(index + len == total){
    Serial.printf("BodyEnd: %u B\n", total);
  }
}

void setup() {
  Serial.begin(115200);
  delay(10);
  // pinMode(ledPin, OUTPUT);
  // pinMode(LED_BUILTIN, OUTPUT);
  //Starting demultiplex inputs
  for (int i=0; i<4; i++) pinMode(demultPos[i], OUTPUT);
  for (int i=0; i<4; i++) pinMode(demultNeg[i], OUTPUT);
  pinMode(negDemultPin, OUTPUT);
  
  // Connect to WiFi network
  Serial.println();
  Serial.println();
  Serial.print("Connecting to ");
  Serial.println(ssid);

  //WiFi.begin(ssid, password);
  WiFi.softAP(ssid, password);

  IPAddress IP = WiFi.softAPIP();

  /*while (WiFi.status() != WL_CONNECTED) {
    delay(500);
    Serial.print(".");
  }*/
  Serial.println("");
  Serial.println("WiFi connected");

  // Start the server
  server.begin();
  Serial.println("Server started");

  // Print the IP address
  Serial.print("Use this URL to connect: ");
  Serial.print("http://");
  Serial.print(IP);
  Serial.println("/");

  server.on("/test", HTTP_GET, [](AsyncWebServerRequest *request) {
    status = status == HIGH ? LOW : HIGH;
    // digitalWrite(ledPin, status);
    Serial.println(request->params());
    if (request->hasParam("teste"))
      Serial.println(request->getParam("teste")->value());
    
    request->send_P(200, "text/plain", "CONTENTE XD");
    
  });

  AsyncCallbackJsonWebHandler* handler = new AsyncCallbackJsonWebHandler("/change",[](AsyncWebServerRequest *request, JsonVariant &json) {
    JsonObject jsonObj = json.as<JsonObject>();
    int newStatus = jsonObj["status"];
    Serial.println(newStatus);
    // if(newStatus == 1) Serial.println("ok")
    // else                Serial.println("Error");
    
    if (newStatus > 16) {
      request->send_P(400, "text/plain", "Limit: 16");  
    } else {
      status = newStatus;

      request->send_P(200, "text/plain", "okay");
    }
  });
  server.addHandler(handler);

  server.onRequestBody(onBody);

}

// void restartMatriz() {
//   if (debugging) {
//     for (int i; i<3; i++) 
//       for (int j; j<3; j++)
//         debugMatrix[i][j] = 0;
    
//   }
// }

void loop() {

  for (int i=0; i<maxRow; i++){

    for (int j=0;j<maxColumn;j++) {
      if (constelationMatrix[status][i][j]) {

        // digitalWrite(negDemultPin, HIGH);

        // Serial.printf("i=%d  -  j=%d\n\n", i, j);
        // delay(5000);
        // Serial.printf("A=%d - B=%d - C=%d, D=%d", demultMap[i][0], demultMap[i][1], demultMap[i][2], demultMap[i][3]);
        // delay(5000);
        // Serial.printf("A=%d - B=%d - C=%d, D=%d", demultMap[j][0], demultMap[j][1], demultMap[j][2], demultMap[j][3]);
        // delay(5000);

        for (int k=0; k<4; k++) {
          digitalWrite(demultPos[k], demultMap[i][k]);
          // Serial.printf("\n\nSetting %d as %d\n\n", demultPos[k], demultMap[c][k]);

          digitalWrite(demultNeg[k], demultMap[j][k]);
          // Serial.printf("\n\nSetting %d as %d\n\n", demultPos[k], demultMap[r][k]);
          delay(1);
        }

      }


    }
  }

  
}